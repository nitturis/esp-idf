## examples/wifi/getting_started/AC/main/Kconfig.projbuild
```kconfig
menu "Example Configuration"

config ESP_WIFI_SSID
    string "WiFi SSID"
    default "myssid"
    help
	SSID (network name) for the example to connect to.

config ESP_WIFI_PASSWORD
    string "WiFi Password"
    default "mypassword"
    help
	WiFi password (WPA or WPA2) for the example to use.

config EXAMPLE_PORT
    int "port number"
    default 8000
    help
	port number of tcp server.
	
config MAX_STA_CONN
    int "Maximal STA connections"
    default 4
    help
	Max number of the STA connects to AP.
endmenu
```
